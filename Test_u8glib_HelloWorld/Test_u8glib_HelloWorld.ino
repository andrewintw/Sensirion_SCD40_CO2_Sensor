#include "U8glib.h"

U8GLIB_SSD1306_128X64 u8g(13, 11, 10, 9);   // SW SPI Com: SCK = 13, MOSI = 11, CS = 10, A0/DC = 9, RES/RST = arduino RST pin

#define RST_PIN     8 /* if you want to manually control by GPIO pin */

void draw(void) {
  u8g.firstPage();
  do {
    // graphic commands to redraw the complete screen should be placed here
    u8g.setFont(u8g_font_unifont);
    u8g.setPrintPos(0, 20);
    char *tmp = "Hello World !";
    u8g.print(tmp);
    u8g.setPrintPos(0, 40);
    u8g.print(millis());
    u8g.setPrintPos(0, 60);
    u8g.print("123456789ABCDEF");
  } while ( u8g.nextPage() );
}

void resetOLED() {
  pinMode(RST_PIN, OUTPUT);
  digitalWrite(RST_PIN, LOW);
  delay(100);
  digitalWrite(RST_PIN, HIGH);
}

void setup(void) {
  // flip screen, if required
  // u8g.setRot180();

  resetOLED();
}

#define u8g_logo_width 38
#define u8g_logo_height 24
//static unsigned char u8g_logo_bits[] = {
static unsigned char u8g_logo_bits[] U8G_PROGMEM = {
  0xff, 0xff, 0xff, 0xff, 0x3f, 0xff, 0xff, 0xff, 0xff, 0x3f, 0xe0, 0xe0,
  0xff, 0xff, 0x3f, 0xe3, 0xe1, 0xff, 0xff, 0x3f, 0xf3, 0xf1, 0xff, 0xff,
  0x3f, 0xf3, 0xf1, 0xfe, 0xbf, 0x37, 0xf3, 0x11, 0x1c, 0x1f, 0x30, 0xf3,
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  0xff, 0x3f, 0xff, 0xff, 0xff, 0xff, 0x3f, 0xff, 0xff, 0xff, 0xff, 0x3f
};

void clearScreen(void) {
  u8g.firstPage();
  do {
  } while (u8g.nextPage());
}

void drawLogo(void) {
  u8g.firstPage();
  do {
    u8g.drawXBMP( 0, 0, u8g_logo_width, u8g_logo_height, u8g_logo_bits);
  } while ( u8g.nextPage() );
}

void loop(void) {
  clearScreen();
  delay(2000);
  drawLogo();
  delay(4000);
  draw();
  delay(6000);
}
